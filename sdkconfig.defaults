## sdkconfig.defaults
```kconfig
# =============================================================
# Kiconex Box Lite — sdkconfig.defaults
# Valores por defecto para ESP32. Ajustar según MCU final.
# =============================================================

# --- Target -------------------------------------------------
CONFIG_IDF_TARGET="esp32"

# --- WiFi ---------------------------------------------------
CONFIG_ESP_WIFI_STATIC_RX_BUFFER_NUM=10
CONFIG_ESP_WIFI_DYNAMIC_RX_BUFFER_NUM=32
CONFIG_ESP_WIFI_TX_BUFFER_TYPE_DYNAMIC=y
CONFIG_ESP_WIFI_AMPDU_TX_ENABLED=y
CONFIG_ESP_WIFI_AMPDU_RX_ENABLED=y

# --- MQTT (esp-mqtt) ----------------------------------------
CONFIG_MQTT_BUFFER_SIZE=4096
CONFIG_MQTT_TASK_STACK_SIZE=6144
CONFIG_MQTT_OUTBOX_EXPIRED_TIMEOUT_MS=30000

# --- Watchdog -----------------------------------------------
CONFIG_ESP_TASK_WDT=y
CONFIG_ESP_TASK_WDT_TIMEOUT_S=30
CONFIG_ESP_TASK_WDT_CHECK_IDLE_TASK_CPU0=y

# --- Logging ------------------------------------------------
CONFIG_LOG_DEFAULT_LEVEL_INFO=y
CONFIG_LOG_MAXIMUM_LEVEL_VERBOSE=y
CONFIG_LOG_COLORS=y

# --- NVS ----------------------------------------------------
CONFIG_NVS_ASSERT_ERROR_CHECK=y

# --- Heap ---------------------------------------------------
CONFIG_HEAP_CORRUPTION_DETECTION_LIGHT=y

# --- Stack sizes --------------------------------------------
CONFIG_ESP_MAIN_TASK_STACK_SIZE=4096

# --- FreeRTOS -----------------------------------------------
CONFIG_FREERTOS_USE_TRACE_FACILITY=y
CONFIG_FREERTOS_GENERATE_RUN_TIME_STATS=y
CONFIG_FREERTOS_HZ=100
```
